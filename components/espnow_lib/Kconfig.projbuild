## components/espnow_lib/Kconfig.projbuild
```kconfig
menu "ESP-NOW Library Configuration"

    config ESPNOW_PCB_NAME
        string "Device Identifier Name"
        default "ESP32-Device"
        help
            Set a custom name to identify this device during ESP-NOW discovery.
            This name will be used instead of MAC address for easier identification.

    config ESPNOW_CHANNEL
        int "WiFi Channel"
        default 1
        range 1 14
        help
            The WiFi channel on which ESP-NOW will operate. All devices must use the same channel.

    config ESPNOW_SEND_DELAY
        int "Send Delay (ms)"
        default 1000
        range 0 10000
        help
            Delay between sending two ESPNOW data packets, unit: ms.

    config ESPNOW_ENABLE_LONG_RANGE
        bool "Enable Long Range Mode"
        default "y"
        help
            When enabled, the PHY rate will be reduced to increase range at the expense of bandwidth.

    config ESPNOW_ENABLE_ENCRYPTION
        bool "Enable Encryption"
        default "n"
        help
            Enable or disable encryption for ESP-NOW communication. When disabled, 
            communication will be unencrypted for better performance and lower power 
            consumption, but less secure.

    if ESPNOW_ENABLE_ENCRYPTION
        config ESPNOW_PMK
            string "ESPNOW primary master key"
            default "pmk1234567890123"
            help
                ESPNOW primary master key. The length should be 16 bytes.
                Only used when encryption is enabled.

        config ESPNOW_LMK
            string "ESPNOW local master key"
            default "lmk1234567890123"
            help
                ESPNOW local master key. The length should be 16 bytes.
                Only used when encryption is enabled.
    endif

    config ESPNOW_MAX_PEERS
        int "Maximum number of peers"
        default 20
        range 1 20
        help
            Maximum number of ESP-NOW peers that can be stored and managed.

    config ESPNOW_DISCOVERY_TIMEOUT
        int "Peer Discovery Timeout (ms)"
        default 30000
        range 1000 300000
        help
            Timeout for peer discovery phase in milliseconds.

endmenu
```

## main/Kconfig.projbuild
```kconfig
menu "Example Configuration"

    config ESPNOW_PCB_NAME
        string "PCB Identifier Name"
        default "ESP32-PCB"
        help
            Set a custom name to identify this PCB/device in logs during ESP-NOW discovery.
            This name will be used instead of MAC address for easier identification.

    config ESPNOW_CHANNEL
        int "Channel"
        default 1
        range 0 14
        help
            The channel on which sending and receiving ESPNOW data.

    config ESPNOW_SEND_DELAY
        int "Send delay"
        default 1000
        range 0 65535
        help
            Delay between sending two ESPNOW data, unit: ms.

    config ESPNOW_SEND_LEN
        int "Send len"
        range 10 250
        default 20
        help
            Length of ESPNOW data to be sent, unit: byte.

    config ESPNOW_ENABLE_LONG_RANGE
        bool "Enable Long Range"
        default "y"
        help
            When enable long range, the PHY rate of ESP32 will be 512Kbps or 256Kbps

    config ESPNOW_ENABLE_POWER_SAVE
        bool "Enable ESPNOW Power Save"
        default "y"
        select ESP_WIFI_STA_DISCONNECTED_PM_ENABLE
        depends on ESPNOW_WIFI_MODE_STATION
        help
            With ESPNOW power save enabled, chip would be able to wakeup and sleep periodically
            Notice ESP_WIFI_STA_DISCONNECTED_PM_ENABLE is essential at Wi-Fi disconnected

    config ESPNOW_WAKE_WINDOW
        int "ESPNOW wake window, unit in millisecond"
        range 0 65535
        default 50
        depends on ESPNOW_ENABLE_POWER_SAVE
        help
            ESPNOW wake window

    config ESPNOW_WAKE_INTERVAL
        int "ESPNOW wake interval, unit in millisecond"
        range 1 65535
        default 100
        depends on ESPNOW_ENABLE_POWER_SAVE
        help
            ESPNOW wake interval

    config ESPNOW_ENABLE_ENCRYPTION
        bool "Enable Encryption"
        default "n"
        help
            Enable or disable encryption for ESP-NOW communication. When disabled, 
            communication will be unencrypted for better performance and lower power 
            consumption, but less secure.

    if ESPNOW_ENABLE_ENCRYPTION
        config ESPNOW_PMK
            string "ESPNOW primary master key"
            default "pmk1234567890123"
            help
                ESPNOW primary master key. The length should be 16 bytes.
                Only used when encryption is enabled.

        config ESPNOW_LMK
            string "ESPNOW local master key"
            default "lmk1234567890123"
            help
                ESPNOW local master key. The length should be 16 bytes.
                Only used when encryption is enabled.
    endif

endmenu
```
